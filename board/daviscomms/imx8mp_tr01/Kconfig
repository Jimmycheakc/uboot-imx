## board/daviscomms/imx8mp_tr01/Kconfig
```kconfig
if TARGET_IMX8MP_TR01

config SYS_BOARD
	default "imx8mp_tr01"

config SYS_VENDOR
	default "daviscomms"

config SYS_CONFIG_NAME
	default "imx8mp_tr01"

config IMX_CONFIG
	default "board/daviscomms/imx8mp_tr01/imximage-8mp-lpddr4.cfg"

source "board/freescale/common/Kconfig"

endif
```
